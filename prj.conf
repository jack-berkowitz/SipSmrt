## CMakeLists.txt
```
cmake_minimum_required(VERSION 3.20.0)
find_package(Zephyr REQUIRED HINTS $ENV{ZEPHYR_BASE})

project(SipSmrt)

target_sources(app PRIVATE src/main.c src/sensor_ble.c)
```

## prj.conf
```kconfig
# BLE
CONFIG_BT=y
CONFIG_BT_PERIPHERAL=y
CONFIG_BT_DEVICE_NAME="SipSmrt"
CONFIG_BT_GATT_CLIENT=y

# Logging
CONFIG_LOG=y

# nRF52 DK helper
CONFIG_DK_LIBRARY=y

# Float processing
CONFIG_FPU=y


##### Connection parameters
## Latencey between connection intervals
CONFIG_BT_PERIPHERAL_PREF_MIN_INT=800 
CONFIG_BT_PERIPHERAL_PREF_MAX_INT=800 
## Peripheral latency
CONFIG_BT_PERIPHERAL_PREF_LATENCY=0
## Timeout time
CONFIG_BT_PERIPHERAL_PREF_TIMEOUT=400
## Automatically send request to update connection parameteres to the ones set above after a connection has been made
CONFIG_BT_GAP_AUTO_UPDATE_CONN_PARAMS=y 
## Update PHY
CONFIG_BT_USER_PHY_UPDATE=y

# Stacks
#CONFIG_SYSTEM_WORKQUEUE_STACK_SIZE=2048
#CONFIG_MAIN_STACK_SIZE=2048
#CONFIG_ISR_STACK_SIZE=2048

# Debug/guards (highly recommended while bringing up)
#CONFIG_ASSERT=y
#CONFIG_DEBUG=y
#CONFIG_DEBUG_OPTIMIZATIONS=y
#CONFIG_THREAD_NAME=y
#CONFIG_THREAD_STACK_INFO=y
#CONFIG_INIT_STACKS=y
#CONFIG_STACK_SENTINEL=y
#CONFIG_HW_STACK_PROTECTION=y
```

## src/main.c
```c
#include <zephyr/kernel.h>
#include <zephyr/logging/log.h>
LOG_MODULE_REGISTER(SipSmrtTest, LOG_LEVEL_INF);

#include <zephyr/bluetooth/bluetooth.h>
#include <zephyr/bluetooth/conn.h>
#include <zephyr/bluetooth/gap.h>
#include <zephyr/bluetooth/gatt.h>
#include <zephyr/bluetooth/uuid.h>
#include <zephyr/bluetooth/addr.h>

#include "sensor_ble.h"

// For testing
#include <dk_buttons_and_leds.h>
#define USER_LED DK_LED3

#define RUN_STATUS_LED DK_LED1
#define RUN_LED_BLINK_INTERVAL 1000

#define DEVICE_NAME     CONFIG_BT_DEVICE_NAME
#define DEVICE_NAME_LEN (sizeof(DEVICE_NAME) - 1)

#define COMPANY_ID_CODE 0x0069 //NEED TO SET THIS WHEN MANUFACTURING --> become bluetooth SIG memeber to get Company ID
//#define SIPSMRT_SERVICE_UUID    BT_UUID_128_ENCODE(0xf13a6b98, 0x6ee2, 0x4f4c, 0x9091, 0x7ce8dce35b60) //This is random   

#define NOTIFY_INTERVAL 250
#define STACKSIZE 1024
#define PRIORITY 7

static uint32_t app_FSR_val = 5;
static uint32_t app_BAT_state = 95;

struct bt_conn *my_conn = NULL;
static struct k_work adv_work;

// Advertising options 800 <-> 801 --> 500 <-> 500.625 
static const struct bt_le_adv_param *adv_param = BT_LE_ADV_PARAM(BT_LE_ADV_OPT_CONN|BT_LE_ADV_OPT_USE_IDENTITY, 800, 801, NULL);

// Declare Manufacutring Data
typedef struct adv_mfg_data {
        uint16_t company_code;
} adv_mfg_data_type;
static adv_mfg_data_type adv_mfg_data = {COMPANY_ID_CODE};

// Advertising Packet
static const struct bt_data ad[] = {
        BT_DATA_BYTES(BT_DATA_FLAGS, (BT_LE_AD_GENERAL | BT_LE_AD_NO_BREDR)),
        BT_DATA(BT_DATA_NAME_COMPLETE, DEVICE_NAME, DEVICE_NAME_LEN),
        BT_DATA(BT_DATA_MANUFACTURER_DATA, (unsigned char *)&adv_mfg_data, sizeof(adv_mfg_data)),
};


// Scan Response Packet (currently empty)
static const struct bt_data sd[] = { 
        BT_DATA_BYTES(BT_DATA_UUID128_ALL, BT_UUID_SIPSMRT_VAL)
};


// Advertising handler
static void adv_work_handler(struct k_work *work) {
        int err = bt_le_adv_start(adv_param, ad, ARRAY_SIZE(ad), sd, ARRAY_SIZE(sd));

        if (err) {
                printk("Advertising failed to start (err %d)\n", err);
                return;
        }

        printk("Advertising successfully started\n");
}

// Advertising start
static void advertising_start(void) {
        k_work_submit(&adv_work);
}

//Setting PHY mode
// static void update_phy(struct bt_conn *conn) {
//         int err;
//         const struct bt_conn_le_phy_param preferred_phy = {
//                 .options = BT_CONN_LE_PHY_OPT_NONE,
//                 //Set PHY mode below
//                 .pref_rx_phy = BT_GAP_LE_PHY_1M,
//                 .pref_tx_phy = BT_GAP_LE_PHY_1M,
//         };
//         err = bt_conn_le_phy_update(conn, &preferred_phy);
//         if (err) {
//                 LOG_ERR("bt_conn_le_phy_update() returned %d", err);
//         }
// }

// On Connected (CB)
void on_connected(struct bt_conn *conn, uint8_t err) {
        if (err) {
                LOG_ERR("Connection error %d", err);
                return;
        }
        LOG_INF("Connected");
        my_conn = bt_conn_ref(conn);


        // Get connection INFO
        struct bt_conn_info info;
        err = bt_conn_get_info(conn, &info);
        if (err) {
                LOG_ERR("bt_conn_get_info() returned %d", err);
                return;
        }
        double connection_interval = info.le.interval * 1.25; //in ms
        uint16_t supervision_timeout = info.le.timeout * 10; //in ms
        LOG_INF("Connection parameters: interval %.2f ms, latency %d intervals, timeout %d ms", connection_interval, info.le.latency, supervision_timeout);

}

// On Disconnected (CB)
void on_disconnected(struct bt_conn *conn, uint8_t reason) {
        LOG_INF("Disconnected. Reason %d", reason);
        bt_conn_unref(my_conn);
}

// On Recycled --> a connection object is returned to the pool = typically when you have enoucntered a disconnection and on of the connections has been unfereenced; therefore can start advertising again
void on_recycled(void) {
        advertising_start();
}

// On connection param update
void on_le_param_updated(struct bt_conn *conn, uint16_t interval, uint16_t latency, uint16_t timeout) {
        double connection_interval = interval * 1.25;
        uint16_t supervision_timeout = timeout * 10;
        LOG_INF("Connection parameters update: interval %.2f ms, latency %d intervals, timeout %d ms", connection_interval, latency, supervision_timeout);
}

// // On PHY updated - IGNORED --> Central has complex nigotiation -- leave it up to the central to decide
// void on_le_phy_updated(struct bt_conn *conn, struct bt_conn_le_phy_info *param) {
//         if (param->tx_phy == BT_GAP_LE_PHY_1M) {
//                 LOG_INF("PHY updated. New PHY: 1M");
//         } else if (param->tx_phy == BT_GAP_LE_PHY_2M) {
//                 LOG_INF("PHY updated. New PHY: 2M");
//         } else if (param->tx_phy == BT_GAP_LE_PHY_CODED) {
//                 LOG_INF("PHY updated. New PHY: Long range");
//         }
// }

// Callback for the CAL
static void app_CAL_cb(bool CAL_state) {
        dk_set_led(USER_LED, CAL_state);
        LOG_INF("**** CAL state changed ****");
}

// // Callback for the FSR bv    
// static int app_FSR_cb(void) {
//         return app_FSR_val;
// }
static void simulate_data(void) {
        app_FSR_val++;
        if (app_FSR_val == 200) {
                app_FSR_val = 100;
        }
}

void send_data_thread(void) {
        while(1){
                simulate_data();
                my_sensor_send_FSR_notify(app_FSR_val);
                k_sleep(K_MSEC(NOTIFY_INTERVAL));
        }
}

K_THREAD_DEFINE(send_data_thread_id, STACKSIZE, send_data_thread, NULL, NULL, NULL, PRIORITY, 0, 0);

// Callback for the BAT
static int app_BAT_cb(void) {
        return app_BAT_state;
}

// Callbacks -- GATT exchange
static struct my_sensor_cb app_callbacks = {
        .CAL_cb = app_CAL_cb,
        //.FSR_cb = app_FSR_cb,
        .BAT_cb = app_BAT_cb,
};



// Callbacks -- BT connection
BT_CONN_CB_DEFINE(connection_callbacks) = {
        .connected = on_connected,
        .disconnected = on_disconnected, 
        .recycled = on_recycled,
        .le_param_updated = on_le_param_updated,
        //.le_phy_updated = on_le_phy_updated,
};


int main(void)    
{
        int err;
        int blink_status = 0;

        LOG_INF("Starting DUT");

        /* Initialize DK LEDs (required before dk_set_led) */
        err = dk_leds_init();
        if (err) {
                LOG_ERR("dk_leds_init failed (err %d)", err);
                return -1;
        }

        bt_addr_le_t addr;
        err = bt_addr_le_from_str("FF:EE:DD:CC:BB:AA", "random", &addr); //create new random static address
        if (err) {
                printk("Invalid BT address (err %d)\n", err);
        }
        err = bt_id_create(&addr, NULL); //convert address to string for BLE
        if (err < 0) {
                printk("Creating new ID failed (err %d)\n", err);
        }


        // Enable BLE on board
        err = bt_enable(NULL);
        if (err) {
                LOG_ERR("Bluetooth init failed (err %d)", err);
                return -1;
        }
        LOG_INF("BLE initialized");


        k_work_init(&adv_work, adv_work_handler);
        advertising_start();

        LOG_INF("Advertising successfully started");

        // Pass application callback functions store in app_callbacks to the My Sensor service
        err = sensor_init(&app_callbacks);
        if (err) {
                printk("Failed to init LBS (err:%d)\n", err);
        }
        //Forever loop
        for (;;) {
                dk_set_led(RUN_STATUS_LED, (++blink_status) & 0x1);
                k_sleep(K_MSEC(RUN_LED_BLINK_INTERVAL));
        }
}
      
```

## src/sensor_ble.c
```c
#include <zephyr/types.h>
#include <stddef.h>
#include <string.h>
#include <errno.h>
#include <zephyr/sys/printk.h>
#include <zephyr/sys/byteorder.h>
#include <zephyr/kernel.h>

#include <zephyr/bluetooth/bluetooth.h>
#include <zephyr/bluetooth/hci.h>
#include <zephyr/bluetooth/conn.h>
#include <zephyr/bluetooth/uuid.h>
#include <zephyr/bluetooth/gatt.h>

#include "sensor_ble.h"

#include <zephyr/logging/log.h>

LOG_MODULE_DECLARE(Lesson4_Exercise1);

static bool notify_FSR_enabled;
int FSR_VAL;
int BAT_VAL;
static struct my_sensor_cb sensor_cb;



/* STEP 6 - Implement the write callback function of the LED characteristic */

/* STEP 5 - Implement the read callback function of the Button characteristic */

//// FSR read callback function
// static ssize_t read_FSR(struct bt_conn *conn, const struct bt_gatt_attr *attr, void *buff, uint16_t len, uint16_t offset) {
//     // Pointer to FSR val whihc is passed in the BT_GATT_CHARACTERISTIC() and stored in attr -> user_data
//     const char *value = attr->user_data;
//     LOG_DBG("Attribute read, handle: %u, conn: %p", attr->handle, (void *)conn);

//     if (sensor_cb.FSR_cb) {
//         // Call the application callback function to update/get the current value of the FSR
//         FSR_VAL = sensor_cb.FSR_cb();
//         return bt_gatt_attr_read(conn, attr, buff, len, offset, value, sizeof(*value));
//     }

//     return 0;
// }

static void sensorbc_ccc_FSR_cfg_changed(const struct bt_gatt_attr *attr, uint16_t value) {
    notify_FSR_enabled = (value == BT_GATT_CCC_NOTIFY);
}

// BAT read callback function
static ssize_t read_BAT(struct bt_conn *conn, const struct bt_gatt_attr *attr, void *buff, uint16_t len, uint16_t offset) {
    // Pointer to BAT val whihc is passed in the BT_GATT_CHARACTERISTIC() and stored in attr -> user_data
    const char *value = attr->user_data;
    LOG_DBG("Attribute read, handle: %u, conn: %p", attr->handle, (void *)conn);

    if (sensor_cb.BAT_cb) {
        // Call the application callback function to update/get the current value of the BAT
        BAT_VAL = sensor_cb.BAT_cb();
        return bt_gatt_attr_read(conn, attr, buff, len, offset, value, sizeof(*value));
    }

    return 0;
}

// Calibration write callback function
static ssize_t write_CAL(struct bt_conn *conn, const struct bt_gatt_attr *attr, const void *buff, uint16_t len, uint16_t offset, uint8_t flags) {
    LOG_DBG("Attribute write, handle: %u, conn: %p", attr->handle, (void *)conn);

    if (len != 1U) {
        LOG_DBG("Write CAL: Incorrect data length");
        return BT_GATT_ERR(BT_ATT_ERR_INVALID_ATTRIBUTE_LEN);
    }

    if (offset != 0) {
        LOG_DBG("Write CAL: Incorrect data offset");
        return BT_GATT_ERR(BT_ATT_ERR_INVALID_OFFSET);
    }

    if (sensor_cb.CAL_cb) {
        // Read the recieved value
        uint8_t val = *((uint8_t *)buff);

        if (val == 0x00 || val == 0x01) {
            // Call the application callback function to update the CAL state
            sensor_cb.CAL_cb(val? true : false);
        } else {
            LOG_DBG("Write CAL: Incorrect value");
            return BT_GATT_ERR(BT_ATT_ERR_VALUE_NOT_ALLOWED);
        }
    }

    return len;
}


/* Sensor Service Declaration */

BT_GATT_SERVICE_DEFINE(my_sensor_svc, 
    BT_GATT_PRIMARY_SERVICE(BT_UUID_SIPSMRT), 
    BT_GATT_CHARACTERISTIC(BT_UUID_SIPSMRT_FSR, BT_GATT_CHRC_NOTIFY, BT_GATT_PERM_NONE, NULL, NULL, NULL),
    BT_GATT_CCC(sensorbc_ccc_FSR_cfg_changed, BT_GATT_PERM_READ | BT_GATT_PERM_WRITE),
    BT_GATT_CHARACTERISTIC(BT_UUID_SIPSMRT_BAT, BT_GATT_CHRC_READ, BT_GATT_PERM_READ, read_BAT, NULL, &BAT_VAL),
    BT_GATT_CHARACTERISTIC(BT_UUID_SIPSMRT_CAL, BT_GATT_CHRC_WRITE, BT_GATT_PERM_WRITE, NULL, write_CAL, NULL),
);

/* A function to register application callbacks for the FSR, BAT, & CAL characteristics  */
int sensor_init(struct my_sensor_cb *callbacks)
{
	if (callbacks) {
		sensor_cb.FSR_cb = callbacks->FSR_cb;
        sensor_cb.BAT_cb = callbacks->BAT_cb;
        sensor_cb.CAL_cb = callbacks->CAL_cb;
	}

	return 0;
}

int my_sensor_send_FSR_notify(uint32_t FSR_VAL) {
    if (!notify_FSR_enabled) {
        return -EACCES;
    }

    return bt_gatt_notify(NULL, &my_sensor_svc.attrs[2], &FSR_VAL, sizeof(FSR_VAL));
}
```

## src/sensor_ble.h
```c
#pragma once //IDK THIS
#ifdef __cplusplus
extern "C" {
#endif

#include <zephyr/types.h>
#include <stdbool.h>
#include <zephyr/bluetooth/uuid.h>

/* Service UUID (bytes for adv + handle for GATT) */
#define BT_UUID_SIPSMRT_VAL       BT_UUID_128_ENCODE(0xf13a6b12, 0x6ee2, 0x4f4c, 0x9091, 0x7ce8dce35b60)
#define BT_UUID_SIPSMRT           BT_UUID_DECLARE_128(BT_UUID_SIPSMRT_VAL)

/* FSR Characteristic UUID */
#define BT_UUID_SIPSMRT_FSR_VAL   BT_UUID_128_ENCODE(0xf13a6b13, 0x6ee2, 0x4f4c, 0x9091, 0x7ce8dce35b60)
#define BT_UUID_SIPSMRT_FSR       BT_UUID_DECLARE_128(BT_UUID_SIPSMRT_FSR_VAL)

/* Battery Characteristic UUID */
#define BT_UUID_SIPSMRT_BAT_VAL   BT_UUID_128_ENCODE(0xf13a6b14, 0x6ee2, 0x4f4c, 0x9091, 0x7ce8dce35b60)
#define BT_UUID_SIPSMRT_BAT       BT_UUID_DECLARE_128(BT_UUID_SIPSMRT_BAT_VAL)

/* Calibrate Characteristic UUID */
#define BT_UUID_SIPSMRT_CAL_VAL   BT_UUID_128_ENCODE(0xf13a6b15, 0x6ee2, 0x4f4c, 0x9091, 0x7ce8dce35b60)
#define BT_UUID_SIPSMRT_CAL       BT_UUID_DECLARE_128(BT_UUID_SIPSMRT_CAL_VAL)

/* App callback types */
typedef void (*CAL_cb_t)(bool CAL);
typedef int  (*FSR_cb_t)(void);
typedef int  (*BAT_cb_t)(void);

struct my_sensor_cb {
    FSR_cb_t FSR_cb;
    BAT_cb_t BAT_cb;
    CAL_cb_t CAL_cb;
};

/* Service init */
int sensor_init(struct my_sensor_cb *callbacks);

#ifdef __cplusplus
}
#endif
```
